## soc/arm/silabs_exx32/efr32bg22/Kconfig.defconfig.efr32bg22
```kconfig
# Silicon Labs EFR32BG22 (Blue Gecko) MCU configuration options

# Copyright (c) 2020 Cargomon Systems GmbH
# SPDX-License-Identifier: Apache-2.0

config GPIO_GECKO
	default y
	depends on GPIO || LOG_BACKEND_SWO

config UART_GECKO
	default y
	depends on SERIAL

config I2C_GECKO
	default y
	depends on I2C

config SOC_FLASH_GECKO
	default y
	depends on FLASH
```

## soc/arm/silabs_exx32/efr32bg22/Kconfig.defconfig.series
```kconfig
# Silicon Labs EFR32BG22 (Blue Gecko) series configuration options

# Copyright (c) 2020 Cargomon Systems GmbH
# SPDX-License-Identifier: Apache-2.0

if SOC_SERIES_EFR32BG22

config SOC_SERIES
	default "efr32bg22"

config SOC_PART_NUMBER
	default "EFR32BG22C224F512IM40" if SOC_PART_NUMBER_EFR32BG22C224F512IM40

config NUM_IRQS
	int
	# must be >= the highest interrupt number used
	default 61

source "soc/arm/silabs_exx32/efr32bg22/Kconfig.defconfig.efr32bg22"

endif # SOC_SERIES_EFR32BG22
```
